## utils/meta-intel-sdo/conf/layer.conf
```bitbake
# We have a conf and classes directory, add to BBPATH
BBPATH .= ":${LAYERDIR}"

# We have recipes-* directories, add to BBFILES
BBFILES += "${LAYERDIR}/recipes-*/*/*.bb \
            ${LAYERDIR}/recipes-*/*/*.bbappend"

BBFILE_COLLECTIONS += "meta-intel-sdo"
BBFILE_PATTERN_meta-intel-sdo = "^${LAYERDIR}/"
BBFILE_PRIORITY_meta-intel-sdo = "7"

LAYERDEPENDS_meta-intel-sdo = "core"
LAYERSERIES_COMPAT_meta-intel-sdo = "warrior dunfell zeus"
```
